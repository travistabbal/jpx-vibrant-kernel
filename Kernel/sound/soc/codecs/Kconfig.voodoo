## Kernel/sound/soc/codecs/Kconfig.voodoo
```kconfig
config SND_VOODOO
	bool "Voodoo sound driver"
	depends on SND_S3C24XX_SOC
	default y
	help
	  With this option enabled, the kernel compile an additionnal driver
	  that extend the existing sound driver

config SND_VOODOO_HPVOL
	int "Default headphone amplifier level: 0-62"
	depends on SND_VOODOO && SND_ARIES_SOC_WM8994
	default 47
	range 0 62
	help
	  Adds a control to enable or disable the high-pass filter on FM radio

config SND_VOODOO_FM
	bool "FM radio: restore a normal frequency response"
	depends on SND_VOODOO && SND_ARIES_SOC_WM8994
	default y
	help
	  Adds a control to enable or disable the high-pass filter on FM radio

config SND_VOODOO_DEBUG
	bool "Codec development tools (unsafe and introduce sound skipping)"
	depends on SND_VOODOO && SND_ARIES_SOC_WM8994
	default n
	help
	  Log codec writes
```
